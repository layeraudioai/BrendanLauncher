/* generated by hbx-build */
ENTRY(_start)
SECTIONS
{
  . = 0xc000000;
  .text : {
    *(.text.entry)
    *(.text .text.*)
  }
  . = ALIGN(16);
  .rodata : { *(.rodata .rodata.*) }
  . = ALIGN(16);
  __code_end = .;

  . = 0xd000000;
  .data : { *(.data .data.*) }
  . = ALIGN(16);
  __bss_start = .;
  .bss (NOLOAD) : {
    *(.bss .bss.*)
    *(COMMON)
  }
  . = ALIGN(16);
  __bss_end = .;
  __data_end = .;
}
